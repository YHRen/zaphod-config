## boards/arm/zaphod/Kconfig
```kconfig
# SPDX-License-Identifier: MIT

config BOARD_ENABLE_DCDC
	bool "Enable DCDC mode"
	select SOC_DCDC_NRF52X
	default y
	depends on BOARD_ZAPHOD

if ZMK_DISPLAY

config ZAPHOD_HOSTNAME_0
    string "Hostname for Bluetooth profile 0"
    default "macbook"

config ZAPHOD_HOSTNAME_1
    string "Hostname for Bluetooth profile 1"
    default "iphone"

config ZAPHOD_HOSTNAME_2
    string "Hostname for Bluetooth profile 2"
    default "android"

config ZAPHOD_HOSTNAME_3
    string "Hostname for Bluetooth profile 3"
    default "PC"

config ZAPHOD_HOSTNAME_4
    string "Hostname for Bluetooth profile 4"
    default "TV-box"

menuconfig ZAPHOD_BONGO_CAT
    bool "Show WPM bongo cat"
    select ZMK_WPM
    select LV_USE_IMG
    select LV_USE_ANIMATION

if ZAPHOD_BONGO_CAT

config ZAPHOD_BONGO_CAT_IDLE_LIMIT
    int "Upper limit for WPM for showing idle animation"
    default 30

config ZAPHOD_BONGO_CAT_SLOW_LIMIT
    int "Upper limit for WPM for showing slow typing image"
    default 60

endif # ZAPHOD_BONGO_CAT


endif
```

## boards/shields/xiao_trackpoint_test/Kconfig.defconfig
```kconfig
# Copyright (c) 2026 The Zaphod Contributors
# SPDX-License-Identifier: MIT

if SHIELD_XIAO_TRACKPOINT_TEST

config ZMK_KEYBOARD_NAME
    default "XIAO TrackPoint"

endif
```

## boards/shields/xiao_trackpoint_test/Kconfig.shield
```kconfig
# Copyright (c) 2026 The Zaphod Contributors
# SPDX-License-Identifier: MIT

config SHIELD_XIAO_TRACKPOINT_TEST
    def_bool $(shields_list_contains,xiao_trackpoint_test)
```

## boards/shields/zaphod_lite/Kconfig.defconfig
```kconfig
# Copyright (c) 2020 The ZMK Contributors
# SPDX-License-Identifier: MIT

if SHIELD_ZAPHOD_LITE

config ZMK_KEYBOARD_NAME
    default "Zaphod Lite"

config SPI
	default y

config ZMK_DISPLAY
	select LV_USE_CONT
	select LV_FONT_MONTSERRAT_26

choice ZMK_DISPLAY_STATUS_SCREEN
	default ZMK_DISPLAY_STATUS_SCREEN_CUSTOM
endchoice

config ZMK_DISPLAY_STATUS_SCREEN_CUSTOM
	select LV_USE_LABEL

if ZMK_DISPLAY

config ZMK_WIDGET_BATTERY_STATUS
	default y if ZMK_BATTERY_REPORTING

config ZMK_WIDGET_OUTPUT_STATUS
	default y if ZMK_BLE

config ZMK_WIDGET_LAYER_STATUS
	default y

config ZMK_WIDGET_WPM_STATUS
	default y

config ZAPHOD_HOSTNAME_0
    string "Hostname for Bluetooth profile 0"
    default "macbook"

config ZAPHOD_HOSTNAME_1
    string "Hostname for Bluetooth profile 1"
    default "iphone"

config ZAPHOD_HOSTNAME_2
    string "Hostname for Bluetooth profile 2"
    default "android"

config ZAPHOD_HOSTNAME_3
    string "Hostname for Bluetooth profile 3"
    default "PC"

config ZAPHOD_HOSTNAME_4
    string "Hostname for Bluetooth profile 4"
    default "TV-box"

config SYSTEM_WORKQUEUE_STACK_SIZE
	default 2048

config LV_Z_MEM_POOL_SIZE
	default 4096

choice LV_FONT_DEFAULT
	default LV_FONT_DEFAULT_MONTSERRAT_26
endchoice

choice ZMK_LV_FONT_DEFAULT_SMALL
	default ZMK_LV_FONT_DEFAULT_SMALL_MONTSERRAT_26
endchoice

config LS0XX
	default y

config LV_Z_BITS_PER_PIXEL
	default 1

choice LV_COLOR_DEPTH
	default LV_COLOR_DEPTH_1
endchoice

config LV_DPI_DEF
	default 30

config LV_Z_VDB_SIZE
	default 16

endif # ZMK_DISPLAY

endif # SHIELD_ZAPHOD_LITE
```

## boards/shields/zaphod_trackpoint/Kconfig.shield
```kconfig
# Copyright (c) 2026 The Zaphod Contributors
# SPDX-License-Identifier: MIT

config SHIELD_ZAPHOD_TRACKPOINT
	def_bool $(shields_list_contains,zaphod_trackpoint)
```

## boards/shields/zaphod_trackpoint_display_replacement/Kconfig.shield
```kconfig
# SPDX-License-Identifier: MIT

config SHIELD_ZAPHOD_TRACKPOINT_DISPLAY_REPLACEMENT
    def_bool $(shields_list_contains,zaphod_trackpoint_display_replacement)
```

## config/west.yml
```yaml
manifest:
  remotes:
    - name: zmkfirmware
      url-base: https://github.com/zmkfirmware
    - name: infused-kim
      url-base: https://github.com/infused-kim
  projects:
    - name: zmk
      remote: zmkfirmware
      revision: v0.3
      import: app/west.yml
    - name: kb_zmk_ps2_mouse_trackpoint_driver
      remote: infused-kim
      revision: f6f3b30677caeccc4970bb48f48240d3504d03f7
  self:
    path: config
```
